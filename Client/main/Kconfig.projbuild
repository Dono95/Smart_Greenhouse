## Client/main/Kconfig.projbuild
```kconfig
menu "Greenhouse"
    menu "Greenhouse general"
        config CLIENT_ID
            int "Client ID"
            default 0
    
        choice CLIENT_POSITION
            prompt "Client position"
            default INSIDE
            help 
                The client's position within the greenhouse
               
            config INSIDE
                bool "Inside"
    
            config OUTSIDE
                bool "Outside"
        endchoice
    endmenu

    menu "Bluetooth"
        config BLUETOOTH_SERVER
            string "Bluetooth server"
            default "Greenhouse"

            help
                Bluetooth server name
    endmenu

    menu "Sensor" 
        config TEMPERATURE
            bool "Temperature"
            default y
    
            help
                Enable/Disable measure temperature
    
        config HUMANITY
            bool "Humanity"
            default y
    
            help
                Enable/Disable measure humanity
        
        config CO2
            bool "CO2"
            default n
    
            help
                Enable/Disable measure CO2

        config SOIL_MOISURE
            bool "Soil moisure"
            default n
    
            help
                Enable/Disable measure soil moisure
    endmenu

    menu "Indicator"
        config RED_PIN
            int "Red color pin"
            default -1
        
        config GREEN_PIN
            int "Green color pin"
            default -1
        
        config BLUE_PIN
            int "Blue color pin"
            default -1
    endmenu
endmenu
```

## Common_components/Kconfig.projbuild
```kconfig
menu "Convertors configuration"
    config JSON_Number_Precision
        int "JSON Number precision"
        default 3
        
        help 
            The number represent a floating-point precision when a number is converted to string
endmenu

menu "General"
    config ENABLE_NETWORK
        bool "Enable network"
        default n

        help 
            Enable network
endmenu

menu "Network"
    depends on ENABLE_NETWORK

    choice SERVER_TYPE
        prompt "Server_Type"
        default STANDALONE_SERVER
        help 
            Server solution for project. All services on standalone server with only one provided
            IP address or hostname. Multi server configuration value provide ip configuration for 
            each service individually.
            
        config STANDALONE_SERVER
            bool "Standalone-Server"
        config MULTI_SERVER
            bool "Multi-Server"
    endchoice

    config SERVER_HOST
        depends on STANDALONE_SERVER
        string "Server Host"
        default "192.168.0.105"
    menu "WiFi"
        config WiFi_SSID
            string "WiFi SSID"
            default "ESP"
    
            help 
                WiFi network name
        
        config WiFi_PASSWORD
            string "WiFi Password"
            default "Password"
            
            help 
                WiFi network password
    endmenu
    menu "MQTT"
        config MQTT_HOST
            depends on MULTI_SERVER
            string "MQTT Broker Host"
            default "192.168.0.105"
        
            help 
                MQTT Broker IP
            
        config MQTT_PORT
            string "MQTT Broker Port"
            default "1883"
        
        config MQTT_CLIENT_NAME
            string "MQTT Client name"
            default "ESP_Client"
                
    endmenu

    menu "NTP"
        config NTP_HOST
            depends on MULTI_SERVER
            string "NTP Host"
            default "192.168.0.104"

        config TIME_ZONE
            string "Time zone"
            default "CET-1CEST,M3.5.0,M10.5.0/3"
    endmenu
endmenu
```

## Server/components/Managers/Kconfig.projbuild
```kconfig
menu "Network configuration"

    config WiFi_SSID
        string "WiFi SSID"
        default "ESP"

        help 
            WiFi network name
    
    config WiFi_Password
        string "WiFi Password"
        default "Password"
        
        help 
            WiFi network password
endmenu

menu "MQTT"

    config MQTT_URI
        string "MQTT Broker URI"
        default "192.168.0.105"

        help 
            MQTT Broker URI
    
    config MQTT_Port
        string "MQTT Broker Port"
        default "1883"
        
        help 
            MQTT Broker URI
    
    config MQTT_Client_name
        string "MQTT Client name"
        default "ESP_Client"
        
        help 
            MQTT Client name
endmenu
```

## Server/main/Kconfig.projbuild
```kconfig
menu "General"
    config Greenhouse_ID
        int "Greenhouse ID"
        default 0

        help 
            Set ID of greenhouse

    config ESP_Board
        string "ESP Board type"
        default "esp-wroom-32"

        help 
            Type of main ESP Board

    menu "Motor"
        config COIL_A
            int "COIL A"
            default -1
    
            help 
                Pin number to coil A
                
        config COIL_B
            int "COIL B"
            default -1
            
            help 
                Pin number to coil B

        config COIL_C
            int "COIL C"
            default -1
    
            help 
                Pin number to coil C
        config COIL_D
            int "COIL D"
            default -1
            
            help 
                Pin number to coil D
    endmenu
    menu "Water pump"
        config WATER_PUMP
            int "Water pump"
            default -1
            
            help 
                Pin number to water pump   
    endmenu
endmenu
```
